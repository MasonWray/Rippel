/*
 * The firmware side of the espresso machine: the code a product team owns.
 *
 * It starts the UI generated by `rippel build`, pushes readings in through
 * ui_set_* and implements the actions in ui_actions_t. There's no real machine
 * attached, so this simulates one: a boiler that heats up, and a pump that
 * follows each recipe's pressure profile.
 */
#include <math.h>
#include <stdbool.h>
#include <stdint.h>
#include <stdlib.h>
#include "esp_log.h"
#include "esp_timer.h"
#include "freertos/FreeRTOS.h"
#include "freertos/task.h"
#include "hx8357.h"
#include "lvgl.h"
#include "touch.h"
#include "ui.h"

#define MACHINE_PERIOD_MS 40
#define STATUS_PERIOD_MS  5000

#define PHASE_IDLE 0
#define PHASE_DONE 4

typedef struct {
    float until;
    float from;
    float to;
    uint8_t phase;
} segment_t;

typedef struct {
    const segment_t * segments;
    int count;
    float duration_s;
} recipe_t;

#define SEGMENTS(list) list, sizeof(list) / sizeof(list[0])

static const segment_t classic[] = { { 6, 1, 3, 1 }, { 9, 3, 9, 2 }, { 28, 9, 9, 3 } };
static const segment_t bloom[] = { { 4, 0, 4, 1 }, { 13, 4, 2, 1 }, { 16, 2, 9, 2 }, { 32, 9, 6, 3 } };
static const segment_t lever[] = { { 5, 2, 4, 1 }, { 7, 4, 10, 2 }, { 26, 10, 4, 3 } };
static const segment_t turbo[] = { { 2, 2, 3, 1 }, { 4, 3, 6, 2 }, { 18, 6, 6, 3 } };

static const recipe_t recipes[] = {
    { SEGMENTS(classic), 28 },
    { SEGMENTS(bloom), 32 },
    { SEGMENTS(lever), 26 },
    { SEGMENTS(turbo), 18 },
};

static const char * TAG = "espresso";

static float boiler = 62;
static float boiler_target = 93;
static const recipe_t * shot;
static float shot_yield_g;
static float shot_seconds;
static float pressure;
static float weight;
static float flow;
static uint8_t water = 78;

static uint32_t tick_ms(void)
{
    return (uint32_t)(esp_timer_get_time() / 1000);
}

static float jitter(float size)
{
    return ((float)rand() / (float)RAND_MAX - 0.5f) * 2 * size;
}

static float clampf(float value, float low, float high)
{
    return value < low ? low : value > high ? high : value;
}

static const segment_t * segment_at(const recipe_t * recipe, float seconds)
{
    for(int i = 0; i < recipe->count; i++) {
        if(seconds < recipe->segments[i].until) return &recipe->segments[i];
    }
    return &recipe->segments[recipe->count - 1];
}

static float pressure_at(const recipe_t * recipe, float seconds)
{
    const segment_t * segment = segment_at(recipe, seconds);
    float start = segment == recipe->segments ? 0 : segment[-1].until;
    float t = clampf((seconds - start) / (segment->until - start), 0, 1);
    return segment->from + (segment->to - segment->from) * t;
}

static void finish_shot(void)
{
    if(!shot) return;
    shot = NULL;
    ui_set_phase(PHASE_DONE);
    ui_set_flow_ml_s(0);
    water = water > 4 ? water - 4 : 0;
    ui_set_water_pct(water);
    ESP_LOGI(TAG, "Shot finished at %.1f g", weight);
}

/* Actions the UI calls */

static void on_set_boiler_target(uint8_t celsius)
{
    ESP_LOGI(TAG, "Boiler target: %d C", celsius);
    boiler_target = celsius;
}

static void on_start_shot(uint8_t recipe, uint16_t yield_g)
{
    ESP_LOGI(TAG, "Starting recipe %d, aiming for %d g", recipe, yield_g);
    shot = &recipes[recipe];
    shot_yield_g = yield_g;
    shot_seconds = 0;
    pressure = 0;
    weight = 0;
    flow = 0;
    ui_set_weight_g(0);
    ui_set_elapsed_ds(0);
}

static void on_set_beep(bool on)
{
    ESP_LOGI(TAG, "End-of-shot beep: %s", on ? "on" : "off");
}

static void on_stop_shot(void)
{
    finish_shot();
}

static void on_ack_shot(void)
{
    ui_set_phase(PHASE_IDLE);
}

static void machine_tick(float dt)
{
    /* The brew water pulls the boiler down a little during a shot. */
    float hold = shot ? boiler_target - 0.6f : boiler_target;
    boiler += (hold - boiler) * clampf(dt * 0.45f, 0, 1) + jitter(0.03f);
    ui_set_boiler_c(boiler);

    if(!shot) {
        pressure *= clampf(1 - dt * 5, 0, 1);
        ui_set_pressure_bar(pressure);
        return;
    }

    shot_seconds += dt;
    float progress = clampf(shot_seconds / shot->duration_s, 0, 1);
    pressure += (pressure_at(shot, shot_seconds) - pressure) * clampf(dt * 7, 0, 1) + jitter(0.04f);

    /* Nothing reaches the cup until the puck has soaked through. */
    float dripping = clampf((progress - 0.18f) / 0.82f, 0, 1);
    float next_weight = shot_yield_g * powf(dripping, 1.12f);
    float next_flow = dt > 0 ? (next_weight - weight) / dt : 0;
    flow += (next_flow - flow) * clampf(dt * 5, 0, 1) + jitter(0.03f);
    weight = next_weight;

    ui_set_phase(segment_at(shot, shot_seconds)->phase);
    ui_set_elapsed_ds((uint16_t)lroundf(shot_seconds * 10));
    ui_set_pressure_bar(pressure > 0 ? pressure : 0);
    ui_set_flow_ml_s(flow > 0 ? flow : 0);
    ui_set_weight_g(weight);

    if(progress >= 1) finish_shot();
}

static void log_status(void)
{
    lv_mem_monitor_t mem;
    lv_mem_monitor(&mem);
    ESP_LOGI(TAG, "boiler=%.1f lvgl_used=%u KB lvgl_peak=%u KB stack_free=%u",
             boiler, (unsigned)((mem.total_size - mem.free_size) / 1024), (unsigned)(mem.max_used / 1024),
             (unsigned)uxTaskGetStackHighWaterMark(NULL));
}

void app_main(void)
{
    lv_init();
    lv_tick_set_cb(tick_ms);

    lv_display_t * disp = hx8357_create_display();
    touch_create_indev(disp);

    static const ui_actions_t actions = {
        .set_boiler_target = on_set_boiler_target,
        .start_shot = on_start_shot,
        .set_beep = on_set_beep,
        .stop_shot = on_stop_shot,
        .ack_shot = on_ack_shot,
    };
    ui_set_actions(&actions);
    ui_init(disp);

    uint32_t last_tick = tick_ms();
    uint32_t last_status = last_tick;
    while(true) {
        uint32_t wait = lv_timer_handler();

        uint32_t elapsed = lv_tick_elaps(last_tick);
        if(elapsed >= MACHINE_PERIOD_MS) {
            last_tick = tick_ms();
            machine_tick((float)elapsed / 1000.0f);
        }
        if(lv_tick_elaps(last_status) >= STATUS_PERIOD_MS) {
            last_status = tick_ms();
            log_status();
        }
        vTaskDelay(pdMS_TO_TICKS(LV_CLAMP(2, wait, 10)));
    }
}
