/*
 * The firmware side of the thermostat: the code a product team owns.
 *
 * It sets up the board, starts the UI generated by `rippel build`, pushes
 * sensor readings in through ui_set_* and implements the actions in ui_actions_t.
 * Both thermostat firmware projects build this file, one per board.
 *
 * The sensors are simulated. The room drifts toward the setpoint and the
 * battery slowly drains. On a board without touch nobody can change the
 * setpoint, so the room wanders on its own instead.
 */
#include <stdlib.h>
#include "esp_log.h"
#include "esp_timer.h"
#include "freertos/FreeRTOS.h"
#include "freertos/task.h"
#include "lvgl.h"
#include "rippel_board.h"
#include "ui.h"

#define SENSOR_PERIOD_MS 2000

static const char * TAG = "thermostat";
static int16_t room = 22;
static int16_t setpoint_c = 21;
static uint8_t battery = 87;
static uint32_t readings;

static uint32_t tick_ms(void)
{
    return (uint32_t)(esp_timer_get_time() / 1000);
}

static void on_setpoint(int16_t celsius)
{
    ESP_LOGI(TAG, "New setpoint: %d C", celsius);
    setpoint_c = celsius;
}

static void read_sensors(void)
{
    readings++;
#if BOARD_HAS_TOUCH
    if(room < setpoint_c) room++;
    else if(room > setpoint_c) room--;
#else
    room += (int16_t)(rand() % 3) - 1;
    room = LV_CLAMP(16, room, 28);
#endif
    ui_set_temperature(room);

    if(readings % 5 == 0) {
        battery = battery > 5 ? battery - 1 : 100;
        ui_set_battery_pct(battery);
    }
    ESP_LOGI(TAG, "room=%d setpoint=%d battery=%d", room, setpoint_c, battery);
}

void app_main(void)
{
    lv_init();
    lv_tick_set_cb(tick_ms);

    lv_display_t * disp = board_create_display();
    board_create_input(disp);

    static const ui_actions_t actions = { .setpoint = on_setpoint };
    ui_set_actions(&actions);
    ui_init(disp);

    uint32_t last_read = tick_ms();
    while(true) {
        uint32_t wait = lv_timer_handler();
        if(lv_tick_elaps(last_read) >= SENSOR_PERIOD_MS) {
            last_read = tick_ms();
            read_sensors();
        }
        vTaskDelay(pdMS_TO_TICKS(LV_CLAMP(5, wait, 20)));
    }
}
